## sdkconfig.defaults
```kconfig
CONFIG_PARTITION_TABLE_CUSTOM=y

#CONFIG_LOG_DEFAULT_LEVEL_DEBUG=y
CONFIG_LOG_DEFAULT_LEVEL_INFO=y


CONFIG_ESP_HTTPS_OTA_ALLOW_HTTP=y
CONFIG_BOOTLOADER_APP_ROLLBACK_ENABLE=y
CONFIG_ESPTOOLPY_FLASHSIZE_DETECT=y

#CONFIG_FREERTOS_TIMER_TASK_STACK_DEPTH=4096
```
